## sdkconfig.defaults
```kconfig
# Target
CONFIG_IDF_TARGET="esp32s3"

# Flash
CONFIG_ESPTOOLPY_FLASHSIZE_32MB=y
CONFIG_ESPTOOLPY_FLASHMODE_QIO=y

# Partition table
CONFIG_PARTITION_TABLE_CUSTOM=y
CONFIG_PARTITION_TABLE_CUSTOM_FILENAME="partitions.csv"

# PSRAM
CONFIG_SPIRAM=y
CONFIG_SPIRAM_MODE_OCT=y
CONFIG_SPIRAM_SPEED_80M=y

# LVGL
CONFIG_LV_COLOR_DEPTH_16=y
CONFIG_BSP_DISPLAY_LVGL_BUF_HEIGHT=100
CONFIG_LV_FONT_MONTSERRAT_20=y
CONFIG_LV_FONT_MONTSERRAT_24=y
CONFIG_LV_FONT_MONTSERRAT_28=y
CONFIG_LV_FONT_MONTSERRAT_32=y
CONFIG_LV_FONT_MONTSERRAT_36=y
CONFIG_LV_FONT_MONTSERRAT_48=y

# I2C
CONFIG_BSP_I2C_NUM=1

# FAT filesystem - long filenames
CONFIG_FATFS_LFN_HEAP=y
CONFIG_FATFS_MAX_LFN=255

# FreeRTOS: 1000 Hz tick for 500 Hz IMU polling
CONFIG_FREERTOS_HZ=1000

# USB console
CONFIG_ESP_CONSOLE_USB_SERIAL_JTAG=y

# Power management — DFS + automatic light sleep (Stage 2)
CONFIG_PM_ENABLE=y
CONFIG_FREERTOS_USE_TICKLESS_IDLE=y
CONFIG_PM_DFS_INIT_AUTO=y

# BSP: don't crash on touch init failure
# CONFIG_BSP_ERROR_CHECK is not set
```
